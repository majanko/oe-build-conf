## conf/bblayers.conf
```bitbake
# LAYER_CONF_VERSION is increased each time build/conf/bblayers.conf
# changes incompatibly
LCONF_VERSION = "5"

BBPATH = "${TOPDIR}"
BBFILES ?= ""

BBLAYERS ?= " \
  ${TOPDIR}/../oe-core/meta \
  ${TOPDIR}/../meta-openembedded/meta-oe \
  ${TOPDIR}/../meta-beagleboard/common-bsp \
  ${TOPDIR}/../meta-beagleboard/meta-beagleboard-extras \
  ${TOPDIR}/../meta-mdm-peiker \
  "

BBLAYERS_NON_REMOVABLE ?= " \
  ${TOPDIR}/../oe-core/meta \
  "

# set the WORKSPACE directory to the project top level directory
# which is in given example 'planck', in case of Qualcomm's OE port
# 'apps_proc'
export WORKSPACE := "${@os.path.abspath(os.path.join(os.path.dirname(bb.data.getVar('FILE', d)),'../..'))}"
```
